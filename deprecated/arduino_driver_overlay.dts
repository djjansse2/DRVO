/dts-v1/;
/plugin/;

/{
    compatible = "ti,beaglebone", "ti,beaglebone-black";
    part-number = "BBB-Arduino_I2C";
    version = "00A0";

    fragment@0 {
        target = <&i2c2>;

        __overlay__ {
            pinctrl-0 = <&i2c2_pins>;

            clock-frequency = <100000>;
            status = "okay";

            arduino_driver: arduino_driver@38 {
                compatible = "arduino_driver";
                reg = <0x38>;
            };
        };
    };
};